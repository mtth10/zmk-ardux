## config/boards/shields/paintbrush_matrix/Kconfig.defconfig
```kconfig
# Copyright (c) 2021 The ZMK Contributors
# SPDX-License-Identifier: MIT

if SHIELD_PAINTBRUSH_MATRIX

config ZMK_KEYBOARD_NAME
	default "Paintbrush"

endif
```

## config/boards/shields/paintbrush_matrix/Kconfig.shield
```kconfig
# Copyright (c) 2021 The ZMK Contributors
# SPDX-License-Identifier: MIT

config SHIELD_PAINTBRUSH_MATRIX
	def_bool $(shields_list_contains,paintbrush_matrix)
```

## config/west.yml
```yaml
manifest:
  remotes:
    - name: zmkfirmware
      url-base: https://github.com/zmkfirmware
    - name: dactylcc
      url-base: https://github.com/cgoates
    - name: mousekeys
      url-base: https://github.com/krikun98
    - name: petejohanson
      url-base: https://github.com/petejohanson
  projects:
    - name: zmk
      remote: zmkfirmware
      revision: main
      import: app/west.yml
  self:
    path: config
```
